## package/batocera/emulators/eden/Config.in
```kconfig
config BR2_PACKAGE_EDEN
	bool "Eden (Nintendo Switch)"
	depends on BR2_x86_64
	select BR2_PACKAGE_BOOST
	select BR2_PACKAGE_BOOST_CONTEXT
	select BR2_PACKAGE_BOOST_FILESYSTEM
	select BR2_PACKAGE_BOOST_SYSTEM
	select BR2_PACKAGE_ENET
	select BR2_PACKAGE_FFMPEG
	select BR2_PACKAGE_FMT
	select BR2_PACKAGE_JSON_FOR_MODERN_CPP
	select BR2_PACKAGE_LIBOPENSSL
	select BR2_PACKAGE_OPUS
	select BR2_PACKAGE_QT6BASE
	select BR2_PACKAGE_QT6CHARTS
	select BR2_PACKAGE_SDL2
	select BR2_PACKAGE_VULKAN_HEADERS
	select BR2_PACKAGE_VULKAN_LOADER
	select BR2_PACKAGE_VULKAN_UTILITY_LIBRARIES
	select BR2_PACKAGE_ZLIB
	select BR2_PACKAGE_ZSTD
	help
	  Eden Nintendo Switch emulator.

	  This package builds Eden from source and installs the native Qt
	  frontend under /usr/bin/eden.
```

## package/batocera/emulators/fex-emu/Config.in
```kconfig
config BR2_PACKAGE_FEX_EMU
	bool "fex-emu"
	select BR2_PACKAGE_OPENSSL
	select BR2_PACKAGE_SQUASHFS
	select BR2_PACKAGE_LLVM
	select BR2_PACKAGE_SQUASHFUSE
	help
	  FEX-Emu is a fast x86 and x86-64 Linux emulator that allows
	  running x86/x86_64 applications on AArch64 Linux systems.

	  This enables transparent execution of x86/x86-64 binaries
	  via Linux binfmt_misc, including support for Steam gaming.

	  https://github.com/FEX-Emu/FEXS
```

## package/batocera/emulators/nanoboyadvance/Config.in
```kconfig
config BR2_PACKAGE_NANOBOYADVANCE
    bool "nanoboyadvance"
    depends on BR2_INSTALL_LIBSTDCPP
    depends on BR2_PACKAGE_HAS_LIBGL
    select BR2_HOST_CMAKE_AT_LEAST_3_24
    select BR2_PACKAGE_SDL2
    select BR2_PACKAGE_BATOCERA_QT6
    select BR2_PACKAGE_QT6WAYLAND if BR2_PACKAGE_BATOCERA_WAYLAND
    select BR2_PACKAGE_LIBGLU if BR2_PACKAGE_XORG7
    help
      NanoBoyAdvance - Accurate Game Boy Advance emulator.
      Requires OpenGL 3.3 Core Profile.

      https://github.com/nba-emu/NanoBoyAdvance

comment "nanoboyadvance needs OpenGL and a toolchain w/ C++"
    depends on !BR2_INSTALL_LIBSTDCPP || !BR2_PACKAGE_HAS_LIBGL
```

## package/batocera/emulators/retroarch/libretro/libretro-citra/Config.in
```kconfig
config BR2_PACKAGE_LIBRETRO_CITRA
    bool "libretro-citra"
    depends on BR2_INSTALL_LIBSTDCPP
    depends on BR2_PACKAGE_HAS_LIBGL
    help
      A libretro Nintendo 3DS core.

      https://github.com/libretro/citra

comment "LIBRETRO_CITRA needs a toolchain w/ C++ and OpenGL"
    depends on !BR2_INSTALL_LIBSTDCPP || !BR2_PACKAGE_HAS_LIBGL
```

## package/batocera/emulators/retroarch/libretro/libretro-mame2015/Config.in
```kconfig
config BR2_PACKAGE_LIBRETRO_MAME2015
	bool "libretro-mame2015"
	help
	  A port of MAME 0.160-ish to libretro

	  https://github.com/libretro/mame2015-libretro
```

## package/batocera/emulators/ryujinx/Config.in
```kconfig
config BR2_PACKAGE_RYUJINX
    bool "ryujinx"
    depends on BR2_x86_64 || BR2_aarch64
    depends on BR2_PACKAGE_XORG7
    select BR2_PACKAGE_SDL2
    select BR2_PACKAGE_OPENAL
    select BR2_PACKAGE_HICOLOR_ICON_THEME
    select BR2_PACKAGE_ADWAITA_ICON_THEME
    select BR2_PACKAGE_LIBRSVG
    select BR2_PACKAGE_XDOTOOL
    help
      Ryujinx is an open-source Nintendo Switch emulator created by gdkchan and written in C sharp.

      Batocera packages the published Linux runtime tarball and stages it
      under /usr/ryujinx.

	    https://ryujinx.org
```

## package/batocera/emulators/vpinball/Config.in
```kconfig
config BR2_PACKAGE_VPINBALL
    bool "vpinball"
    depends on !BR2_STATIC_LIBS
    depends on BR2_PACKAGE_XORG7 || BR2_PACKAGE_WAYLAND
    select BR2_PACKAGE_LIBFREEIMAGE
    select BR2_PACKAGE_LIBPINMAME
    select BR2_PACKAGE_LIBALTSOUND
    select BR2_PACKAGE_LIBDMDUTIL
    select BR2_PACKAGE_LIBDOF
    select BR2_PACKAGE_LIBWINEVBS
    select BR2_PACKAGE_SDL3
    select BR2_PACKAGE_SDL3_IMAGE
    select BR2_PACKAGE_SDL3_TTF
    select BR2_PACKAGE_FFMPEG
    help
      Visual Pinball.
      
      www.vpforums.org

comment "vpinball needs X11 or Wayland and a toolchain w/ dynamic library"
    depends on BR2_STATIC_LIBS || !(BR2_PACKAGE_XORG7 || BR2_PACKAGE_WAYLAND)
```

## package/batocera/emulators/xenia-edge/Config.in
```kconfig
config BR2_PACKAGE_XENIA_EDGE
    bool "xenia-edge"
    depends on BR2_x86_64
    select BR2_PACKAGE_PYTHON_TOML
    help
      Xenia Edge is an experimental fork of Xenia Canary with Linux and Vulkan
      enhancements, distributed here as a native Linux AppImage.

      https://github.com/has207/xenia-edge
```

## package/batocera/emulators/yuzu/Config.in
```kconfig
config BR2_PACKAGE_YUZU
	bool "Yuzu (Nintendo Switch)"
	depends on BR2_x86_64
	help
	  Yuzu Nintendo Switch emulator (AppImage).

	  This package installs the Yuzu AppImage into /usr/share/yuzu
	  with a wrapper script in /usr/bin/yuzu.
```

## package/batocera/ports/opengoal/Config.in
```kconfig
config BR2_PACKAGE_OPENGOAL
	bool "opengoal"
	depends on BR2_x86_64
	depends on BR2_TOOLCHAIN_USES_GLIBC
	depends on BR2_INSTALL_LIBSTDCPP
	select BR2_PACKAGE_ZLIB
	help
	  OpenGOAL runtime, extractor, and compiler for the Jak and Daxter
	  series.

	  Requires a user-supplied original PS2 game ISO at runtime.

	  https://github.com/open-goal/jak-project

comment "opengoal needs an x86_64 glibc C++ toolchain"
	depends on !BR2_x86_64 || !BR2_TOOLCHAIN_USES_GLIBC || \
		!BR2_INSTALL_LIBSTDCPP
```

## package/batocera/ports/unleashed-recomp/Config.in
```kconfig
config BR2_PACKAGE_UNLEASHED_RECOMP
	bool "unleashedrecomp"
	depends on BR2_x86_64
	depends on BR2_TOOLCHAIN_USES_GLIBC
	depends on BR2_INSTALL_LIBSTDCPP
	depends on BR2_TOOLCHAIN_HAS_THREADS
	depends on BR2_USE_WCHAR
	depends on BR2_PACKAGE_HOST_RUSTC_ARCH_SUPPORTS
	depends on BR2_USE_MMU
	depends on BR2_TOOLCHAIN_HAS_SYNC_4
	depends on BR2_TOOLCHAIN_GCC_AT_LEAST_4_9
	depends on BR2_PACKAGE_HAS_LIBEGL || BR2_PACKAGE_HAS_LIBGL
	select BR2_PACKAGE_LIBGTK3
	select BR2_PACKAGE_VULKAN_LOADER
	help
	  Unleashed Recompiled, a native Sonic Unleashed Xbox 360
	  recompilation port.

	  Requires user-supplied original Xbox 360 game/update/DLC files at
	  runtime.

	  https://github.com/hedge-dev/UnleashedRecomp

comment "unleashedrecomp needs an x86_64 glibc C++ toolchain with GTK3 and Vulkan support"
	depends on !BR2_x86_64 || !BR2_TOOLCHAIN_USES_GLIBC || \
		!BR2_INSTALL_LIBSTDCPP || !BR2_TOOLCHAIN_HAS_THREADS || \
		!BR2_USE_WCHAR || !BR2_PACKAGE_HOST_RUSTC_ARCH_SUPPORTS || \
		!BR2_USE_MMU || !BR2_TOOLCHAIN_HAS_SYNC_4 || \
		!BR2_TOOLCHAIN_GCC_AT_LEAST_4_9 || \
		(!BR2_PACKAGE_HAS_LIBEGL && !BR2_PACKAGE_HAS_LIBGL)
```

## package/batocera/utils/batocera-arch-plasma-lxc/Config.in
```kconfig
config BR2_PACKAGE_BATOCERA_ARCH_PLASMA_LXC
	bool "batocera-arch-plasma-lxc"
	depends on BR2_USE_MMU
	depends on BR2_TOOLCHAIN_HAS_THREADS
	depends on !BR2_STATIC_LIBS
	depends on BR2_TOOLCHAIN_GCC_AT_LEAST_4_7
	depends on BR2_TOOLCHAIN_HEADERS_AT_LEAST_3_0
	depends on !BR2_TOOLCHAIN_USES_UCLIBC
	select BR2_PACKAGE_BASH
	select BR2_PACKAGE_DIALOG
	select BR2_PACKAGE_DNSMASQ
	select BR2_PACKAGE_IPTABLES
	select BR2_PACKAGE_LXC
	select BR2_PACKAGE_XTERM
	help
	  Runtime launcher for an Arch Linux KDE Plasma desktop in LXC.
```

## package/batocera/utils/batocera-iio-motion/Config.in
```kconfig
config BR2_PACKAGE_BATOCERA_IIO_MOTION
	bool "batocera-iio-motion"
	depends on BR2_PACKAGE_BATOCERA_TARGET_X86_ANY
	select BR2_PACKAGE_ZLIB
	help
	  Expose a Linux IIO accelerometer and gyroscope as a local
	  DSU/CemuHook motion controller. This is used for integrated
	  handheld sensors such as the BMI323 in the ASUS ROG Ally.
```

## package/batocera/utils/batocera-rpcs3-sync/Config.in
```kconfig
config BR2_PACKAGE_BATOCERA_RPCS3_SYNC
    bool "batocera-rpcs3-sync"
    depends on BR2_x86_64
    help
      Sync installed PSN-style RPCS3 titles from the RPCS3 hdd0 game
      directory into Batocera's PS3 rom listing.
```

## package/batocera/utils/extract-xiso/Config.in
```kconfig
config BR2_PACKAGE_EXTRACT_XISO
    bool "extract-xiso"
    depends on BR2_USE_MMU
    help
      Xbox ISO creation and extraction utility.

      https://github.com/xboxdev/extract-xiso
```

## package/batocera/utils/shadps4-pkg-extractor/Config.in
```kconfig
config BR2_PACKAGE_SHADPS4_PKG_EXTRACTOR
    bool "shadps4-pkg-extractor"
    depends on BR2_x86_64
    help
      PKG extraction helper for regular shadPS4.

      Ships the upstream Linux PKG extractor AppImage and a Batocera
      wrapper script.
```

## package/batocera/utils/waydroid/Config.in
```kconfig
config BR2_PACKAGE_WAYDROID
	bool "waydroid"
	depends on BR2_PACKAGE_BATOCERA_WAYLAND
	depends on BR2_PACKAGE_PYTHON3
	depends on BR2_USE_MMU
	depends on BR2_TOOLCHAIN_HAS_THREADS
	select BR2_PACKAGE_DBUS
	select BR2_PACKAGE_DBUS_PYTHON
	select BR2_PACKAGE_PYTHON_GOBJECT
	select BR2_PACKAGE_PYTHON_GBINDER
	select BR2_PACKAGE_LXC
	select BR2_PACKAGE_IPTABLES
	select BR2_PACKAGE_DNSMASQ
	select BR2_PACKAGE_DIALOG if BR2_x86_64
	select BR2_PACKAGE_EROFS_UTILS if BR2_x86_64
	select BR2_PACKAGE_EROFS_UTILS_LZ4 if BR2_x86_64
	select BR2_PACKAGE_P7ZIP if BR2_x86_64
	select BR2_PACKAGE_SQLITE if BR2_x86_64
	select BR2_PACKAGE_XTERM if BR2_x86_64
	select BR2_PACKAGE_LIBCURL if BR2_x86_64
	select BR2_PACKAGE_LIBCURL_CURL if BR2_x86_64
	select BR2_PACKAGE_LIBCURL_FORCE_TLS if BR2_x86_64
	select BR2_PACKAGE_OPENSSL if BR2_x86_64
	select BR2_PACKAGE_LIBCURL_OPENSSL if BR2_x86_64
	help
	  Waydroid Android container userspace.

	  https://github.com/waydroid/waydroid

comment "waydroid needs Batocera Wayland, python3, MMU and threads"
	depends on !BR2_PACKAGE_BATOCERA_WAYLAND || !BR2_PACKAGE_PYTHON3 || !BR2_USE_MMU || !BR2_TOOLCHAIN_HAS_THREADS
```

## package/batocera/wine/dgvoodoo2/Config.in
```kconfig
config BR2_PACKAGE_DGVOODOO2
	bool "dgVoodoo2"
	depends on BR2_x86_64
	help
	  dgVoodoo2 compatibility wrappers for legacy DirectX and Glide games.

	  https://github.com/dege-diosg/dgVoodoo2
```

## package/batocera/wine/lsfg-vk/Config.in
```kconfig
config BR2_PACKAGE_LSFG_VK
	bool "lsfg-vk"
	depends on BR2_x86_64 || BR2_aarch64
	help
	  Lossless Scaling Frame Generation Vulkan layer.
	  On x86_64 targets this installs a private x64 layer for Wine/Steam.
	  On aarch64 targets this builds the native layer for native Vulkan
	  AppImages and also installs a private x86_64 layer for Wine/FEX. A
	  user-provided Lossless.dll from a purchased Lossless Scaling
	  installation is still required at runtime.

	  https://github.com/PancakeTAS/lsfg-vk
```

## package/batocera/wine/umu-launcher/Config.in
```kconfig
config BR2_PACKAGE_UMU_LAUNCHER
	bool "umu-launcher"
	depends on BR2_x86_64
	select BR2_PACKAGE_LIBCURL_CURL
	help
	  Unified Linux Wine Game Launcher.

	  https://github.com/Open-Wine-Components/umu-launcher
```
